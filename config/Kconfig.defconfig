## config/west.yml
```yaml
manifest:
  remotes:
    - name: cookies4you
      url-base: https://github.com/cookies4you
  projects:
    - name: zmk
      remote: cookies4you
      revision: main
      import: app/west.yml
  self:
    path: config
```
